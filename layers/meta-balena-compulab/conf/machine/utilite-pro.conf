## layers/meta-balena-compulab/conf/machine/utilite-pro.conf
```bitbake
#@TYPE: Machine
#@NAME: Utilite Pro
#@DESCRIPTION: Compulab Utilite Pro board using Compulab CL-SOM-IMX7

MACHINEOVERRIDES = "cl-som-imx6:${MACHINE}"
include conf/machine/cl-som-imx6.conf

# PREFERRED_PROVIDER_virtual/bootloader = "u-boot-imx"
# PREFERRED_VERSION_u-boot-imx = "2018.03"

# PREFERRED_PROVIDER_virtual/kernel = "linux-imx"
# PREFERRED_VERSION_linux-imx = "4.14.98"

# KERNEL_DEVICETREE = "compulab/sbc-imx8-no-wp.dtb"

# MACHINE_ESSENTIAL_EXTRA_RRECOMMENDS += "gov-switch watchdog-config "

# SERIAL_CONSOLES = "115200;ttymxc2"
```
